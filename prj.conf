## CMakeLists.txt
```
cmake_minimum_required(VERSION 3.20.0)
find_package(Zephyr REQUIRED HINTS $ENV{ZEPHYR_BASE})
project(ultra_low_power)

FILE(GLOB app_sources src/*.c)
target_sources(app PRIVATE ${app_sources})
```

## prj.conf
```kconfig
CONFIG_PM=y
# Required to disable default behavior of deep sleep on timeout
CONFIG_PM_DEVICE=y

# Power saving
CONFIG_SERIAL=n
CONFIG_USB_DEVICE_STACK=n

# Needed to communicate with spi flash
CONFIG_SPI=y
# Needed to set spi flash to deep sleep
CONFIG_SPI_NOR_IDLE_IN_DPD=y
# Needs to be turned on, for DPD
CONFIG_FLASH=y

# To make the device flashable without using a bootloader
CONFIG_BUILD_OUTPUT_UF2=n
CONFIG_USE_DT_CODE_PARTITION=n
```

## xiao_ble.overlay
```dts
&xiao_spi {
    status = "disabled";
};
```

## src/main.c
```c
#include <zephyr/device.h>
#include <zephyr/pm/pm.h>
#include <zephyr/pm/device.h>
#include <zephyr/pm/policy.h>
#include <zephyr/drivers/spi.h>

static const struct device *const spi_bus = DEVICE_DT_GET(DT_BUS(DT_ALIAS(spi_flash0)));

void main(void)
{
	int rc;

	if(!device_is_ready(spi_bus))
	{
		return;
	}

	rc = pm_device_action_run(spi_bus, PM_DEVICE_ACTION_SUSPEND);
	if(rc < 0)
	{
		return;
	}

	k_sleep(K_FOREVER);
}
```
